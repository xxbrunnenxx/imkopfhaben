## main/Kconfig.projbuild
```kconfig
menu "Folloup Settings"

    config FOLLOWUP_WIFI_AP_PREFIX
        string "Wi-Fi AP prefix"
        default "Followup"
        help
            Prefix used when the device enters Wi-Fi access-point setup mode.
            The full AP SSID appends the last three Wi-Fi MAC bytes.

    config FOLLOWUP_WIFI_STA_SSID
        string "Built-in Wi-Fi SSID"
        default ""
        help
            Optional built-in station SSID. Runtime-saved NVS credentials take
            precedence when present.

    config FOLLOWUP_WIFI_STA_PASSWORD
        string "Built-in Wi-Fi password"
        default ""
        help
            Optional built-in station password paired with
            FOLLOWUP_WIFI_STA_SSID.

    config FOLLOWUP_WIFI_START_IN_AP_MODE
        bool "Start Wi-Fi in AP setup mode"
        default n
        help
            Start the Wi-Fi backend in access-point setup mode on boot instead
            of first attempting saved or built-in station credentials.

    config FOLLOWUP_TIME_SYNC_DEFAULT_ENABLED
        bool "Enable clock sync by default"
        default y
        help
            When enabled, the timezone service attempts SNTP sync after Wi-Fi
            connects using the configured default timezone.

    config FOLLOWUP_DEFAULT_TIMEZONE_NAME
        string "Default timezone name"
        default "North_America_Eastern"
        help
            Default timezone catalog entry used before a runtime timezone
            setting has been saved in NVS.

    config FOLLOWUP_WELCOME_MESSAGE_ROTATE_HOURS
        int "Dashboard welcome message rotation interval (hours)"
        range 1 720
        default 1
        help
            How many hours between dashboard welcome-message rotations. The
            greeting starts from a random message chosen at boot and advances
            one step every interval, so it changes over time without being
            tied to the calendar.

    config FOLLOWUP_LOCAL_AI_BASE_URL
        string "Local AI server base URL"
        default "http://192.168.178.215:1234/v1/"
        help
            Base URL of the local OpenAI-compatible chat/completions server
            (LM Studio, running google/gemma-4-e2b) used for summaries. A
            runtime-saved base URL stored through the backend portal takes
            precedence when present. No credential is sent -- this is a LAN
            address, not a secret.

    config FOLLOWUP_LOCAL_AI_TRANSCRIBE_URL
        string "Local AI transcription endpoint URL"
        default "http://192.168.178.215:8010/api/transcribe-raw"
        help
            URL of the local transcription endpoint (a thin wrapper around
            faster-whisper). Port 8010 is a placeholder -- this endpoint does
            not exist yet, see docs/local-ai-service.md. A runtime-saved URL
            stored through the backend portal takes precedence when present.

    config FOLLOWUP_AUTO_SLEEP_DISPLAY_SLEEP_TIMEOUT_SECONDS
        int "Display sleep timeout"
        range 0 86400
        default 180
        help
            Seconds of IMU-detected inactivity before the e-paper panel enters
            display sleep. Set to 0 to disable the display-sleep stage.

    config FOLLOWUP_AUTO_SLEEP_LIGHT_SLEEP_TIMEOUT_SECONDS
        int "Light sleep timeout"
        range 0 86400
        default 1800
        help
            Seconds of IMU-detected inactivity before the ESP32-S3 enters light
            sleep. Set to 0 to disable the light-sleep stage. When both display
            sleep and light sleep are enabled, this value must be greater than
            or equal to the display sleep timeout.

endmenu
```
